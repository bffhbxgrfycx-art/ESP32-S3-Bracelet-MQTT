## sdkconfig.defaults
```kconfig
CONFIG_SPIRAM=y
CONFIG_SPIRAM_MODE_OCT=y
CONFIG_SPIRAM_SPEED_80M=y

CONFIG_LV_USE_USER_DATA=y
CONFIG_LV_USE_CHART=y
# 关闭 LVGL 性能监视器（右下角 FPS/CPU 占用率显示）
# CONFIG_LV_USE_PERF_MONITOR is not set

CONFIG_ESPTOOLPY_FLASHSIZE_16MB=y
CONFIG_PARTITION_TABLE_CUSTOM=y

# 表盘大号数字时间字体
CONFIG_LV_FONT_MONTSERRAT_36=y
CONFIG_LV_FONT_MONTSERRAT_40=y
CONFIG_LV_FONT_MONTSERRAT_48=y

# 配网 HTTP 服务器：手机浏览器请求头较长，加大缓冲区避免 431 报错
CONFIG_HTTPD_MAX_REQ_HDR_LEN=2048
CONFIG_HTTPD_MAX_URI_LEN=2048
```
